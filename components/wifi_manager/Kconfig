## components/wifi_manager/Kconfig
```kconfig
menu "Wi-Fi manager"

    config WIFI_MANAGER_DEV_SSID
        string "Development Wi-Fi SSID (optional, do not commit)"
        default ""
        help
            If set, this network is saved as a profile on first boot
            (unless a profile with this SSID already exists), so hardware
            bring-up works without a settings UI yet. Set this only via
            menuconfig, in your local sdkconfig - sdkconfig is gitignored.
            Never put real credentials in sdkconfig.defaults.

    config WIFI_MANAGER_DEV_PASSWORD
        string "Development Wi-Fi password (optional, do not commit)"
        default ""
        help
            Password for WIFI_MANAGER_DEV_SSID. Same rule: local
            sdkconfig only, never sdkconfig.defaults.

endmenu
```

## main/Kconfig.projbuild
```kconfig
menu "Development tools"

    config DEV_SCREENSHOT_CONSOLE
        bool "Enable 'screenshot' console command (dev-only, disable for release builds)"
        default n
        select LV_USE_SNAPSHOT
        help
            Registers a 'screenshot' command on the console REPL that
            captures the current LVGL screen (lv_screen_active()) into a
            PSRAM buffer and streams it back over the same serial port as
            base64 text, for use by tools/dev_screenshot.py. Adds ~768 KB
            of transient PSRAM usage per invocation and pulls in the LVGL
            snapshot API.

            Enable this only via 'idf.py menuconfig' in your local
            sdkconfig (sdkconfig is gitignored). Never set this to y in
            sdkconfig.defaults - it must stay off in production/release
            builds.

    config UI_DIAGNOSTICS
        bool "Enable periodic UI memory diagnostics logging (dev-only)"
        default n
        help
            Logs LVGL pool (lv_mem_monitor), internal-RAM, and PSRAM
            free/largest-block/low-watermark figures - each measured
            separately, since MALLOC_CAP_INTERNAL and MALLOC_CAP_SPIRAM
            describe disjoint regions and OR-ing them into one
            heap_caps_get_free_size() call would silently mix the two -
            plus the active Settings view, live Wi-Fi row count, and
            resident Settings-sub-screen count (should never exceed 1).

            Logged at ESP_LOGI every ~30 ticks of the 1s UI update timer,
            on every Settings view transition, and after each Wi-Fi/
            Watchlist list rebuild - ESP_LOGI rather than ESP_LOGD because
            this project's default CONFIG_LOG_MAXIMUM_LEVEL (INFO) compiles
            ESP_LOGD out entirely, which would make this option silently do
            nothing without also raising the global log ceiling. These
            automatic call sites are compiled out entirely when this option
            is off, so periodic logging costs nothing in a normal build -
            the underlying measurement is still reachable on demand via the
            "memlog" console command (CONFIG_DEV_SCREENSHOT_CONSOLE),
            independent of this option.

            Enable this only via 'idf.py menuconfig' in your local
            sdkconfig (sdkconfig is gitignored). Never set this to y in
            sdkconfig.defaults - it must stay off in production/release
            builds.

endmenu
```

## sdkconfig.defaults
```kconfig
CONFIG_IDF_TARGET="esp32p4"
CONFIG_IDF_TARGET_ESP32P4=y

# Custom partition table: adds encrypted nvs_keys + wifi_cfg partitions for
# the Wi-Fi credential store (see docs/decisions/0001-wifi-connectivity.md).
CONFIG_PARTITION_TABLE_CUSTOM=y
CONFIG_PARTITION_TABLE_CUSTOM_FILENAME="partitions.csv"
CONFIG_NVS_ENCRYPTION=y
CONFIG_NVS_SEC_HMAC_EFUSE_KEY_ID=5

# Anti-rollback boot-loop protection for Phase 10's OTA updates: a newly
# flashed ota_0/ota_1 image boots in ESP_OTA_IMG_PENDING_VERIFY state and
# is only kept on the next boot after app_main() confirms it via
# esp_ota_mark_app_valid_cancel_rollback() - see
# docs/decisions/0006-ota-firmware-update.md.
CONFIG_BOOTLOADER_APP_ROLLBACK_ENABLE=y

# JC4880P443C_I_W boards currently use early ESP32-P4 silicon.
CONFIG_ESP32P4_SELECTS_REV_LESS_V3=y
CONFIG_ESP32P4_REV_MIN_100=y

# Board flash is 16 MB; BOYA flash has been observed on this board family.
CONFIG_ESPTOOLPY_FLASHSIZE_16MB=y
CONFIG_SPI_FLASH_SUPPORT_BOYA_CHIP=y

# Board PSRAM is 32 MB; 200 MHz is the working baseline from the board project.
CONFIG_SPIRAM=y
CONFIG_SPIRAM_MODE_HEX=y
CONFIG_SPIRAM_SPEED_200M=y
CONFIG_SPIRAM_USE_MALLOC=y
CONFIG_SPIRAM_MALLOC_ALWAYSINTERNAL=512
# CONFIG_SPIRAM_TRY_ALLOCATE_WIFI_LWIP is not set
CONFIG_SPIRAM_MALLOC_RESERVE_INTERNAL=32768
CONFIG_SPIRAM_XIP_FROM_PSRAM=y
CONFIG_CACHE_L2_CACHE_256KB=y
CONFIG_CACHE_L2_CACHE_LINE_128B=y

# ESP-IDF defaults to 360 MHz for ESP32-P4 revisions < v3.0.
CONFIG_ESP_DEFAULT_CPU_FREQ_MHZ_360=y

CONFIG_LOG_DEFAULT_LEVEL_INFO=y

# The board's only host-reachable serial port (/dev/cu.usbmodem101) is
# USB-Serial-JTAG, not UART0 - ESP-IDF's default primary console. With
# UART0 as primary, log output reaches this port (mirrored via the
# secondary console) but no REPL input ever does, since nothing reads
# from it - confirmed by hardware test
# (docs/validation/ota-firmware-update-hardware-test.md). Making
# USB-Serial-JTAG the primary console instead makes the same port that
# already carries logs/flashing also accept REPL input.
# CONFIG_ESP_CONSOLE_UART_DEFAULT is not set
CONFIG_ESP_CONSOLE_USB_SERIAL_JTAG=y
CONFIG_ESP_CONSOLE_UART_BAUDRATE=115200
CONFIG_ESP_MAIN_TASK_STACK_SIZE=8192
CONFIG_ESP_TASK_WDT_TIMEOUT_S=20
CONFIG_ESP_SYSTEM_USE_FRAME_POINTER=y
CONFIG_BOOTLOADER_LOG_LEVEL_WARN=y

# ESP32-P4 has no native Wi-Fi; connectivity is via ESP-Hosted over SDIO to
# the on-board ESP32-C6 co-processor. Pin map and slave target are specific
# to the JC4880P443C_I_W board (see docs/hardware/jc4880p443c.md and
# docs/decisions/0001-wifi-connectivity.md).
CONFIG_ESP_HOSTED_ENABLED=y
CONFIG_ESP_HOSTED_SDIO_HOST_INTERFACE=y
CONFIG_ESP_HOSTED_IDF_SLAVE_TARGET="esp32c6"
CONFIG_ESP_HOSTED_SDIO_SLOT_1=y
CONFIG_ESP_HOSTED_SDIO_SLOT=1
CONFIG_ESP_HOSTED_SDIO_4_BIT_BUS=y
CONFIG_ESP_HOSTED_SDIO_BUS_WIDTH=4
CONFIG_ESP_HOSTED_SDIO_CLOCK_FREQ_KHZ=40000
# RX streaming mode stays off: it has triggered ESP-Hosted DMA heap
# fragmentation asserts during long HTTPS transfers on this board family.
CONFIG_ESP_HOSTED_SDIO_OPTIMIZATION_RX_MAX_SIZE=y
CONFIG_ESP_HOSTED_SDIO_TX_Q_SIZE=10
CONFIG_ESP_HOSTED_SDIO_RX_Q_SIZE=10
CONFIG_ESP_HOSTED_PRIV_SDIO_PIN_CMD_SLOT_1=19
CONFIG_ESP_HOSTED_PRIV_SDIO_PIN_CLK_SLOT_1=18
CONFIG_ESP_HOSTED_PRIV_SDIO_PIN_D0_SLOT_1=14
CONFIG_ESP_HOSTED_PRIV_SDIO_PIN_D1_4BIT_BUS_SLOT_1=15
CONFIG_ESP_HOSTED_PRIV_SDIO_PIN_D2_4BIT_BUS_SLOT_1=16
CONFIG_ESP_HOSTED_PRIV_SDIO_PIN_D3_4BIT_BUS_SLOT_1=17
CONFIG_ESP_HOSTED_SDIO_PIN_CMD=19
CONFIG_ESP_HOSTED_SDIO_PIN_CLK=18
CONFIG_ESP_HOSTED_SDIO_PIN_D0=14
CONFIG_ESP_HOSTED_SDIO_PIN_D1=15
CONFIG_ESP_HOSTED_SDIO_PIN_D2=16
CONFIG_ESP_HOSTED_SDIO_PIN_D3=17
CONFIG_ESP_HOSTED_SDIO_GPIO_RESET_SLAVE=54
CONFIG_ESP_HOSTED_GPIO_SLAVE_RESET_SLAVE=54
CONFIG_ESP_HOSTED_SDIO_RESET_DELAY_MS=1500
CONFIG_ESP_HOSTED_SLAVE_RESET_ON_EVERY_HOST_BOOTUP=y
CONFIG_ESP_HOSTED_DFLT_TASK_FROM_SPIRAM=y
CONFIG_ESP_HOSTED_USE_MEMPOOL=y
CONFIG_ESP_HOSTED_MAX_SIMULTANEOUS_SYNC_RPC_REQUESTS=5
CONFIG_ESP_HOSTED_MAX_SIMULTANEOUS_ASYNC_RPC_REQUESTS=5
CONFIG_SLAVE_IDF_TARGET_ESP32C6=y

# Lets a reused esp_http_client handle (market_data_http_next(), used by
# market_data_client_fetch_klines_24h_5m_batch() for the watchlist) resume a
# prior TLS session instead of paying a full handshake on every request.
CONFIG_ESP_TLS_CLIENT_SESSION_TICKETS=y

# Phase 11 dashboard UI: type scale needs more than the default 14px
# Montserrat (12/14 for muted/range labels, 16/18 for ticker/change, 18/20
# for price - bumped per a design-fidelity pass against the reviewed mockup).
CONFIG_LV_FONT_MONTSERRAT_12=y
CONFIG_LV_FONT_MONTSERRAT_16=y
CONFIG_LV_FONT_MONTSERRAT_18=y
CONFIG_LV_FONT_MONTSERRAT_20=y
# Phase 15 Settings > Display: Night mode's hour/minute roller digits need
# a larger face than 20px to read comfortably as a touch-scrollable wheel.
CONFIG_LV_FONT_MONTSERRAT_28=y

# The LVGL object/style pool. 64KB then 128KB (in internal RAM) both proved
# too small: 128KB was sized for the dashboard's row/chart widgets alone (see
# docs/debugging/watchlist-add-freeze.md), but the later Settings > Wi-Fi
# screen renders one ~2KB widget subtree per network in range, and a busy RF
# environment (20+ APs) needs ~40-64KB on top of the ~93KB the rest of the UI
# already holds. That overflowed the 128KB pool mid-build, and LVGL's
# allocation-failure path is catastrophic here - LV_ASSERT_MALLOC traps in an
# infinite while(1) on the LVGL task (silent UI freeze -> task WDT), or a
# near-full/fragmented pool hands back a bad block and faults - which is the
# root cause of the crash/freeze/dead-touch bugs during Wi-Fi navigation (see
# docs/debugging/wifi-nav-pool-exhaustion.md). Rather than keep chasing a
# just-big-enough internal-RAM number, the pool is relocated to PSRAM (see the
# LV_MEM_POOL_ALLOC note below) and
# sized to 512KB - comfortably above the worst-case whole-UI footprint, and
# out of the contended internal RAM shared with esp_hosted/Wi-Fi/TLS. Object
# allocation now hits 200MHz PSRAM; the frame/draw buffers are unaffected
# (they're owned by the board bring-up, not this pool).
#
# The pool is backed from the PSRAM *heap* at boot (LV_MEM_POOL_ALLOC ->
# heap_caps_malloc(MALLOC_CAP_SPIRAM), wired via COMPILE_DEFINITIONS in the
# top-level CMakeLists.txt) rather than a static EXT_RAM_BSS_ATTR array: on
# this pre-rev-v3 ESP32-P4 the linker already runs with
# --enable-non-contiguous-regions, which discards .sbss sections once external
# BSS is enabled (SPIRAM_ALLOW_BSS_SEG_EXTERNAL_MEMORY), so a static PSRAM pool
# won't link. The runtime pool keeps lv_mem_monitor() working and sidesteps
# that entirely.
CONFIG_LV_MEM_SIZE_KILOBYTES=512

# Needed for LV_EVENT_HIT_TEST (display_ui.c's asymmetric_hit_test_cb()):
# without it, lv_hit_test_info_t is only forward-declared and its `point`/
# `res` fields are unreachable from app code, even though the public
# lv_event_get_hit_test_info() accessor itself still compiles fine.
CONFIG_LV_USE_PRIVATE_API=y
```
